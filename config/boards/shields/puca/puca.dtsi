/*
 * Copyright (c) 2020 The ZMK Contributors
 *
 * SPDX-License-Identifier: MIT
 */

#include <dt-bindings/zmk/matrix_transform.h>

/ {

	chosen {
		zmk,kscan = &kscan0;
	};

	encoder_1: encoder_1 {
		compatible = "alps,ec11";
		label = "Encoder 1";
		a-gpios = <&pro_micro 20 (GPIO_ACTIVE_LOW | GPIO_PULL_UP)>;
		b-gpios = <&pro_micro 19 (GPIO_ACTIVE_LOW | GPIO_PULL_UP)>;
		resolution = <4>;
	};

	diode-direction = "col2row";
		row-gpios
			= <&pro_micro 11 (GPIO_ACTIVE_HIGH | GPIO_PULL_DOWN)>
			, <&pro_micro 10 (GPIO_ACTIVE_HIGH | GPIO_PULL_DOWN)>
			, <&pro_micro 9  (GPIO_ACTIVE_HIGH | GPIO_PULL_DOWN)>
			, <&pro_micro 12 (GPIO_ACTIVE_HIGH | GPIO_PULL_DOWN)>
            , <&pro_micro 8  (GPIO_ACTIVE_HIGH | GPIO_PULL_DOWN)>
            , <&pro_micro 18 (GPIO_ACTIVE_HIGH | GPIO_PULL_DOWN)>
            ;
		col-gpios
			= <&pro_micro 17  GPIO_ACTIVE_HIGH>
			, <&pro_micro 16  GPIO_ACTIVE_HIGH>
			, <&pro_micro 15  GPIO_ACTIVE_HIGH>
			, <&pro_micro 14  GPIO_ACTIVE_HIGH>
            , <&pro_micro 13  GPIO_ACTIVE_HIGH>
			;

};